## boards/arm/niuiu_jing34/Kconfig.board
```kconfig
# #34 board configuration

# Copyright (c) 2024 The ZMK Contributors
# SPDX-License-Identifier: MIT

config BOARD_NIUNIU_JING34
    bool "niuiu_jing34"
    depends on SOC_NRF52833_QIAA
```

## boards/arm/niuiu_jing34/Kconfig.defconfig
```kconfig
# #34 board configuration

# Copyright (c) 2024 The ZMK Contributors
# SPDX-License-Identifier: MIT

if BOARD_NIUNIU_JING34

config ZMK_KEYBOARD_NAME
    default "#34"

if USB_DEVICE_STACK

config USB_NRFX
    default y

endif # USB_DEVICE_STACK

config BT_CTLR
    default BT

endif # BOARD_NIUNIU_JING34
```
